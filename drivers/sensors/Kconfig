## drivers/sensors/Kconfig
```kconfig
#
# Miscellaneous I2C chip drivers configuration
#
# *** DEPRECATED! Do not add new entries! See Makefile ***
#

menu "Miscellaneous I2C Chip support"


config SENSORS_YAS_ACCEL_DRIVER
	tristate "ACCEL KERNEL DRIVER"
	depends on I2C

config SENSORS_YAS_ACCEL_POSITION
	int "ACCEL Driver Mounting Position on Board"
	depends on SENSORS_YAS_ACCEL_DRIVER
	default "0"
	help
	  Chip mounting position (pin 1).
	    0: top, upper-left
	    1: top, upper-right
	    2: top, lower-right
	    3: top, lower-left
	    4: bottom, upper-left
	    5: bottom, upper-right
	    6: bottom, lower-right
	    7: bottom, lower-left

config SENSORS_YAS530C
         tristate "YAS Geomagnetic Sensor"
         depends on I2C

config SENSORS_YAS530C_POSITION
         int "YAS Geomagnetic Sensor Mounting Position on Board"
         depends on SENSORS_YAS530C
         default "0"
         help
           Chip mounting position (pin 1).
              0: top, upper-left
              1: top, upper-right
              2: top, lower-right
              3: top, lower-left
              4: bottom, upper-left
              5: bottom, upper-right
              6: bottom, lower-right
              7: bottom, lower-left


config SENSORS_ORIENTATION
	tristate "Yamaha Orientation Sensor"
	depends on I2C

config SENSORS_TAOS
	depends on I2C
	tristate "TAOS driver"
	default n

config OPTICAL_GP2A
	depends on I2C
	tristate "GP2A driver"
	default n

config SENSORS_K2DM
	tristate "STMicro K2DM acceleration sensor support"
	depends on I2C=y
	default n
	help
	  If you say yes here you get support for STMicro's

config SENSORS_KR3DM
	tristate "STMicro K2DM acceleration sensor support"
	depends on I2C=y
	default n
	help
	  If you say yes here you get support for STMicro's

config SENSORS_CORE
	tristate "Sensors core"
	default n
	help
	  Say Y here to enable debugging messages for power supply class
	  and drivers.

endmenu
```
